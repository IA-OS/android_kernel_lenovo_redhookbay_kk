## modules/drivers/input/Kconfig
```kconfig
source "drivers/external_drivers/drivers/input/touchscreen/Kconfig"
source "drivers/external_drivers/drivers/input/misc/Kconfig"
source "drivers/external_drivers/drivers/input/touchscreen/rmi4/Kconfig"
```
